## arch/arm/configs/jfve_defconfig
```kconfig
# CONFIG_MMC_MSM_SDC2_SUPPORT is not set
# CONFIG_MMC_MSM_SDC4_SUPPORT is not set
# CONFIG_BT_BCM4335 is not set
# CONFIG_BCM4335 is not set
CONFIG_WCNSS_CORE=y
CONFIG_WCNSS_MEM_PRE_ALLOC=y
CONFIG_MSM_WCNSS_SSR_8960=y
CONFIG_MSM_PIL_RIVA=y
# CONFIG_MACH_JF_EUR is not set
CONFIG_MACH_JFVE_EUR=y
CONFIG_MACH_JFVE_EUR_LTE=y
# CONFIG_CC_OPTIMIZE_FOR_SIZE is not set
# CONFIG_KERNEL_LZMA is not set
CONFIG_KERNEL_XZ=y

#
# Qualcomm Atheros Prima WLAN module
#
CONFIG_PRIMA_WLAN=y
# CONFIG_PRIMA_WLAN_BTAMP is not set
CONFIG_PRIMA_WLAN_LFR=y
CONFIG_PRIMA_WLAN_OKC=y
CONFIG_PRIMA_WLAN_11AC_HIGH_TP=y
CONFIG_QCOM_VOWIFI_11R=y
CONFIG_QCOM_TDLS=y
```
